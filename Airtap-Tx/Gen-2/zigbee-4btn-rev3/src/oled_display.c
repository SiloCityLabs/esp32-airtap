#include "oled_display.h"
#include <stdio.h>

static const char *TAG = "OLED_DISPLAY";

// Pin definitions
#define PIN_I2C_SDA     22
#define PIN_I2C_SCL     23

// SSD1306 commands
#define SSD1306_DISPLAYOFF 0xAE
#define SSD1306_SETDISPLAYCLOCKDIV 0xD5
#define SSD1306_SETMULTIPLEX 0xA8
#define SSD1306_SETDISPLAYOFFSET 0xD3
#define SSD1306_SETSTARTLINE 0x40
#define SSD1306_CHARGEPUMP 0x8D
#define SSD1306_MEMORYMODE 0x20
#define SSD1306_SEGREMAP 0xA0
#define SSD1306_COMSCANDEC 0xC8
#define SSD1306_SETCOMPINS 0xDA
#define SSD1306_SETCONTRAST 0x81
#define SSD1306_SETPRECHARGE 0xD9
#define SSD1306_SETVCOMDETECT 0xDB
#define SSD1306_DISPLAYALLON_RESUME 0xA4
#define SSD1306_NORMALDISPLAY 0xA6
#define SSD1306_DISPLAYON 0xAF
#define SSD1306_COMSCANINC 0xC0

// Display buffer
static uint8_t display_buffer[SCREEN_WIDTH * SCREEN_HEIGHT / 8];
static bool display_initialized = false;

// Simple 6x8 font (basic ASCII)
static const uint8_t font_6x8[][6] = {
    {0x00, 0x00, 0x00, 0x00, 0x00, 0x00}, // space
    {0x00, 0x00, 0x5F, 0x00, 0x00, 0x00}, // !
    {0x00, 0x07, 0x00, 0x07, 0x00, 0x00}, // "
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    {0x10, 0x08, 0x08, 0x10, 0x08, 0x00}, // ~
};

// I2C functions
static esp_err_t init_i2c(void) {
    i2c_config_t conf = {
        .mode = I2C_MODE_MASTER,
        .sda_io_num = PIN_I2C_SDA,
        .scl_io_num = PIN_I2C_SCL,
        .sda_pullup_en = GPIO_PULLUP_ENABLE,
        .scl_pullup_en = GPIO_PULLUP_ENABLE,
        .master.clk_speed = 400000,
    };
    esp_err_t err = i2c_param_config(I2C_NUM_0, &conf);
    if (err != ESP_OK) return err;
    return i2c_driver_install(I2C_NUM_0, conf.mode, 0, 0, 0);
}

static esp_err_t ssd1306_write_cmd(uint8_t cmd) {
    i2c_cmd_handle_t cmd_handle = i2c_cmd_link_create();
    i2c_master_start(cmd_handle);
    i2c_master_write_byte(cmd_handle, (SCREEN_ADDRESS << 1) | I2C_MASTER_WRITE, true);
    i2c_master_write_byte(cmd_handle, 0x00, true); // Command mode
    i2c_master_write_byte(cmd_handle, cmd, true);
    i2c_master_stop(cmd_handle);
    esp_err_t ret = i2c_master_cmd_begin(I2C_NUM_0, cmd_handle, pdMS_TO_TICKS(100));
    i2c_cmd_link_delete(cmd_handle);
    return ret;
}

static esp_err_t ssd1306_write_data(uint8_t *data, size_t len) {
    i2c_cmd_handle_t cmd_handle = i2c_cmd_link_create();
    i2c_master_start(cmd_handle);
    i2c_master_write_byte(cmd_handle, (SCREEN_ADDRESS << 1) | I2C_MASTER_WRITE, true);
    i2c_master_write_byte(cmd_handle, 0x40, true); // Data mode
    i2c_master_write(cmd_handle, data, len, true);
    i2c_master_stop(cmd_handle);
    esp_err_t ret = i2c_master_cmd_begin(I2C_NUM_0, cmd_handle, pdMS_TO_TICKS(100));
    i2c_cmd_link_delete(cmd_handle);
    return ret;
}

// Display functions
static void draw_char(int x, int y, char c) {
    if (c < 32 || c > 126) c = 32; // Default to space for invalid chars
    const uint8_t *char_data = font_6x8[c - 32];
    
    for (int i = 0; i < 6; i++) {
        uint8_t line = char_data[i];
        for (int j = 0; j < 8; j++) {
            if (line & 0x80) {
                int pixel_x = x + i;
                int pixel_y = y + j;
                if (pixel_x < SCREEN_WIDTH && pixel_y < SCREEN_HEIGHT) {
                    int byte_index = (pixel_y / 8) * SCREEN_WIDTH + pixel_x;
                    int bit_index = pixel_y % 8;
                    display_buffer[byte_index] |= (1 << bit_index);
                }
            }
            line <<= 1;
        }
    }
}

void oled_draw_text(int x, int y, const char *text) {
    int current_x = x;
    while (*text) {
        draw_char(current_x, y, *text);
        current_x += 6;
        text++;
    }
}

void oled_init(void) {
    ESP_ERROR_CHECK(init_i2c());
    
    esp_err_t ret;
    
    // Initialize display
    ret = ssd1306_write_cmd(SSD1306_DISPLAYOFF);
    ret |= ssd1306_write_cmd(SSD1306_SETDISPLAYCLOCKDIV);
    ret |= ssd1306_write_cmd(0x80);
    ret |= ssd1306_write_cmd(SSD1306_SETMULTIPLEX);
    ret |= ssd1306_write_cmd(0x3F);
    ret |= ssd1306_write_cmd(SSD1306_SETDISPLAYOFFSET);
    ret |= ssd1306_write_cmd(0x00);
    ret |= ssd1306_write_cmd(SSD1306_SETSTARTLINE | 0x00);
    ret |= ssd1306_write_cmd(SSD1306_CHARGEPUMP);
    ret |= ssd1306_write_cmd(0x14);
    ret |= ssd1306_write_cmd(SSD1306_MEMORYMODE);
    ret |= ssd1306_write_cmd(0x00);
    // Rotate 180°: mirror segments and use COM scan increment
    ret |= ssd1306_write_cmd(SSD1306_SEGREMAP | 0x1);
    ret |= ssd1306_write_cmd(SSD1306_COMSCANINC);
    ret |= ssd1306_write_cmd(SSD1306_SETCOMPINS);
    ret |= ssd1306_write_cmd(0x12);
    ret |= ssd1306_write_cmd(SSD1306_SETCONTRAST);
    ret |= ssd1306_write_cmd(0xCF);
    ret |= ssd1306_write_cmd(SSD1306_SETPRECHARGE);
    ret |= ssd1306_write_cmd(0xF1);
    ret |= ssd1306_write_cmd(SSD1306_SETVCOMDETECT);
    ret |= ssd1306_write_cmd(0x40);
    ret |= ssd1306_write_cmd(SSD1306_DISPLAYALLON_RESUME);
    ret |= ssd1306_write_cmd(SSD1306_NORMALDISPLAY);
    ret |= ssd1306_write_cmd(SSD1306_DISPLAYON);
    
    if (ret == ESP_OK) {
        display_initialized = true;
        ESP_LOGI(TAG, "OLED display initialized successfully");
    } else {
        ESP_LOGE(TAG, "Failed to initialize OLED display");
    }
}

void oled_clear(void) {
    memset(display_buffer, 0, sizeof(display_buffer));
}

void oled_update_display(float temp_c, int fan_speed, bool pairing_active, bool factory_reset_pending, bool zb_joined, uint32_t uptime_seconds) {
    if (!display_initialized) return;
    
    // Clear display buffer
    memset(display_buffer, 0, sizeof(display_buffer));
    
    // Draw title (flipped Y for 180° rotation)
    oled_draw_text(0, 56, "AirTap T-Series");
    
    // Draw temperature (convert to Fahrenheit)
    float temp_f = temp_c * 9.0f / 5.0f + 32.0f;
    char temp_str[32];
    snprintf(temp_str, sizeof(temp_str), "Temp: %.1fF", temp_f);
    oled_draw_text(0, 44, temp_str);
    
    // Draw fan speed
    char fan_str[32];
    snprintf(fan_str, sizeof(fan_str), "Fan: %d/10", fan_speed);
    oled_draw_text(0, 32, fan_str);
    
    // Draw Zigbee status
    const char *zb_status;
    if (pairing_active) {
        zb_status = "ZB: Pairing...";
    } else if (factory_reset_pending) {
        zb_status = "ZB: Reset...";
    } else if (zb_joined) {
        zb_status = "ZB: Connected";
    } else {
        zb_status = "ZB: Not Joined";
    }
    oled_draw_text(0, 20, zb_status);
    
    // Draw uptime
    char uptime_str[32];
    snprintf(uptime_str, sizeof(uptime_str), "Uptime: %lu sec", uptime_seconds);
    oled_draw_text(0, 8, uptime_str);
    
    // Send buffer to display
    ssd1306_write_data(display_buffer, sizeof(display_buffer));
}
